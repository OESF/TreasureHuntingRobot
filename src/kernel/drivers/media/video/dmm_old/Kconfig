## src/kernel/drivers/media/video/dmm_old/Kconfig
```kconfig
config DMM_OMAP
	bool "OMAP DMM support"
	depends on OMAP4_USE_OLD_API_VIDEO
	default y
	help
           DMM driver for OMAP based boards.
```

## src/kernel/drivers/media/video/omap_old/Kconfig
```kconfig
config VIDEO_OMAP2_VOUT
	tristate "OMAP2/OMAP3/OMAP4 V4L2-Display driver"
	depends on OMAP4_USE_OLD_API_VIDEO
	select VIDEOBUF_GEN
	select VIDEOBUF_DMA_CONTIG
	select OMAP2_DSS
	select OMAP2_VRAM
	default y
	---help---
	  V4L2 Display driver support for OMAP2/3/4 based boards.

config OMAP2_VRFB
	bool
	depends on OMAP4_USE_OLD_API_VIDEO
	default y if VIDEO_OMAP2_VOUT
	help
	  VRFB used in V4L2 in OMAP2,3
```

## src/kernel/drivers/media/video/tiler_old/Kconfig
```kconfig
config TI_TILER
	bool "TI TILER support"
	depends on OMAP4_USE_OLD_API_VIDEO
	default y
	help
           TILER driver for OMAP based boards.
```

## src/kernel/drivers/video/omap2/Kconfig
```kconfig
config OMAP2_VRAM
	bool

config OMAP2_VRFB
	bool
if !OMAP4_USE_OLD_API_VIDEO
source "drivers/video/omap2/dss/Kconfig"
endif
if OMAP4_USE_OLD_API_VIDEO
source "drivers/video/omap2/dss_old/Kconfig"
endif
source "drivers/video/omap2/omapfb/Kconfig"
source "drivers/video/omap2/displays/Kconfig"
```
